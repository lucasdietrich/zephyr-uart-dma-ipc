## Kconfig
```kconfig
config UART_IPC
	bool
	default n
	select SERIAL
    	select UART_ASYNC_API
	help
		Enable support for IPC over UART.

config UART_IPC_STACK_SIZE
	int "UART IPC stack size"
	default 512
	depends on UART_IPC
	help
		Adjust stack size

config UART_IPC_FRAME_BUFFER_COUNT
	int "UART IPC internal memslab messages count"
	default 2
	depends on UART_IPC
	help
		Adjust internal memslab messages count.
		- One for currently being receiving RX frame
		- One for being sent TX frame

config UART_IPC_DMA_BUF_SIZE
	int "UART IPC DMA RX buffers size"
	default 68
	depends on UART_IPC
	help
		Adjust internal DMA RX buffer size, using a low value might cause performance issues,
		using a high value implies a big memory footprint.

config UART_IPC_DEBUG_GPIO_STM32
	bool "UART IPC debug GPIO (STM32)"
	default false
	depends on SOC_SERIES_STM32F4X
	select USE_STM32_HAL_GPIO
	depends on UART_IPC
	help
		Enable debugging using GPIO pins on STM32 chips

config UART_IPC_DEBUG_GPIO_NRF
	bool "UART IPC debug GPIO (NRF)"
	default false
	depends on SOC_SERIES_NRF52X
	select NRFX_GPIOTE
	depends on UART_IPC
	help
		Enable debugging using GPIO pins on NRF chips

choice UART_IPC_DIR
	prompt "UART IPC direction"
	
config UART_IPC_RX
	bool "Enable RX"
	select UART_IPC
	help
		Enable RX support

config UART_IPC_TX
	bool "Enable TX"
	select UART_IPC
	help
		Enable TX support

config UART_IPC_FULL
	bool "Enable RX AND TX"
	select POLL
	select UART_IPC
	help
		Enable RX and TX support

endchoice

config UART_IPC_PING
	bool "Enable ping support"
	default n
	depends on UART_IPC
	help
		Enable ping support for TX direction (implicitely supported for RX)

config UART_IPC_PING_PERIOD
	int "Ping period in milliseconds"
	default 1000
	depends on UART_IPC_PING
	help
		Ping period in milliseconds (ms)

config UART_IPC_STATS
	bool "Enable stats"
	default n
	depends on UART_IPC
	help
		Enable stats for the IPC interface (packet loss, etc.)

config UART_IPC_EVENT_API
	bool "Enable event API"
	default n
	depends on UART_IPC
	help
		Enable event API
```

## zephyr/Kconfig
```kconfig
#
# Copyright (c) 2022 Lucas Dietrich <ld.adecy@gmail.com>
#
# SPDX-License-Identifier: Apache-2.0
#

menuconfig UART_IPC
        bool "Enable UART_IPC module"
		select SERIAL 
		select UART_ASYNC_API
        default n
        help
			Enable support for IPC over UART.

if UART_IPC

module = UART_IPC
module-str = UART_IPC

config UART_IPC_STACK_SIZE
	int "UART IPC stack size"
	default 512
	help
		Adjust stack size

config UART_IPC_FRAME_BUFFER_COUNT
	int "UART IPC internal memslab messages count"
	default 2
	help
		Adjust internal memslab messages count.
		- One for currently being receiving RX frame
		- One for being sent TX frame

config UART_IPC_DMA_BUF_SIZE
	int "UART IPC DMA RX buffers size"
	default 68
	help
		Adjust internal DMA RX buffer size, using a low value might cause performance issues,
		using a high value implies a big memory footprint.

config UART_IPC_DEBUG_GPIO_STM32
	bool "UART IPC debug GPIO (STM32)"
	default false
	depends on SOC_SERIES_STM32F4X
	select USE_STM32_HAL_GPIO
	help
		Enable debugging using GPIO pins on STM32 chips

config UART_IPC_DEBUG_GPIO_NRF
	bool "UART IPC debug GPIO (NRF)"
	default false
	depends on SOC_SERIES_NRF52X
	select NRFX_GPIOTE
	help
		Enable debugging using GPIO pins on NRF chips

choice UART_IPC_DIR
	prompt "UART IPC direction"
	
config UART_IPC_RX
	bool "Enable RX"
	help
		Enable RX support

config UART_IPC_TX
	bool "Enable TX"
	help
		Enable TX support

config UART_IPC_FULL
	bool "Enable RX AND TX"
	select POLL
	help
		Enable RX and TX support

endchoice

config UART_IPC_PING
	bool "Enable ping support"
	default n
	help
		Enable ping support for TX direction (implicitely supported for RX)

config UART_IPC_PING_PERIOD
	int "Ping period in milliseconds"
	default 1000
	depends on UART_IPC_PING
	help
		Ping period in milliseconds (ms)

config UART_IPC_STATS
	bool "Enable stats"
	default n
	help
		Enable stats for the IPC interface (packet loss, etc.)

config UART_IPC_EVENT_API
	bool "Enable event API"
	default n
	help
		Enable event API

config UART_IPC_THREAD_PRIORITY
	bool "IPC thread priority"
	default y
	help
		Select the (cooperative) priority for the IPC thread

config UART_IPC_THREAD_START_DELAY
	int "IPC thread start delay"
	default 0
	help
		Select the delay for the IPC thread start,
		0 means no delay, otherwise the delay is in milliseconds,
		if delay is -1 the thread doesn't start by itself

endif
```
